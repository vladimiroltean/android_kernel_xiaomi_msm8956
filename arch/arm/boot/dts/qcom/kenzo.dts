/*
 * Copyright (c) 2015, The Linux Foundation. All rights reserved.
 *
 * This program is free software; you can redistribute it and/or modify
 * it under the terms of the GNU General Public License version 2 and
 * only version 2 as published by the Free Software Foundation.
 *
 * This program is distributed in the hope that it will be useful,
 * but WITHOUT ANY WARRANTY; without even the implied warranty of
 * MERCHANTABILITY or FITNESS FOR A PARTICULAR PURPOSE.  See the
 * GNU General Public License for more details.
 */

/dts-v1/;

#include "msm8956.dtsi"
#include "kenzo-dsi-panel-tianma-nt35596-1080p-video.dtsi"
#include "kenzo-dsi-panel-boe-nt35532-1080p-video.dtsi"
#include "kenzo-dsi-panel-sharp-r63315-1080p-video.dtsi"
#include "msm8956-mtp.dtsi"

/* Battery profiles
 * Overrides msm8956-mtp.dtsi
 */
/ {
	/delete-node/ qcom,battery-data;
	mtp_batterydata: qcom,battery-data {
		qcom,batt-id-range-pct = <15>;
		#include "kenzo-batterydata-coslight-4000mah-4400mv.dtsi"
		#include "kenzo-batterydata-coslight-4000mah-4400mv-10k.dtsi"
		#include "kenzo-batterydata-sunwoda-4000mah-4400mv.dtsi"
	};
};

/ {
	model = "Qualcomm Technologies, Inc. MSM8956 MTP";
	compatible = "qcom,msm8956-mtp", "qcom,msm8956", "qcom,mtp";
	qcom,board-id = <8 0>;
};
